## package/whisper-model-base-en-q5-1/Config.in
```kconfig
config BR2_PACKAGE_WHISPER_MODEL_BASE_EN_Q5_1
	bool "whisper-model-base-en-q5-1"
	depends on BR2_PACKAGE_WHISPERCPP
	help
	  Bundles the ggml base.en model, 5-bit quantized (~57MB), into
	  the firmware image so speech-to-text transcription works fully
	  offline from first boot, with no in-field download step.

	  Replaces the full fp16 base.en model (too much compute for the
	  RPi4 to sustain - even a single run at 1 thread was enough to
	  trip the hardware watchdog) and tiny.en (ran fine, but dropped
	  or garbled words on real broadcast audio). The q5_1 quantized
	  base.en lands in between: base.en's accuracy at a compute cost
	  this hardware can actually survive.

	  https://huggingface.co/ggerganov/whisper.cpp

comment "whisper-model-base-en-q5-1 needs whispercpp"
	depends on !BR2_PACKAGE_WHISPERCPP
```

## package/whisper-model-base-en/Config.in
```kconfig
config BR2_PACKAGE_WHISPER_MODEL_BASE_EN
	bool "whisper-model-base-en"
	depends on BR2_PACKAGE_WHISPERCPP
	help
	  Bundles the ggml base.en Whisper model (~148MB) into the
	  firmware image so speech-to-text transcription works fully
	  offline from first boot, with no in-field download step.

	  https://huggingface.co/ggerganov/whisper.cpp

comment "whisper-model-base-en needs whispercpp"
	depends on !BR2_PACKAGE_WHISPERCPP
```

## package/whisper-model-tiny-en/Config.in
```kconfig
config BR2_PACKAGE_WHISPER_MODEL_TINY_EN
	bool "whisper-model-tiny-en"
	depends on BR2_PACKAGE_WHISPERCPP
	help
	  Bundles the ggml tiny.en Whisper model (~74MB) into the
	  firmware image so speech-to-text transcription works fully
	  offline from first boot, with no in-field download step.

	  https://huggingface.co/ggerganov/whisper.cpp

comment "whisper-model-tiny-en needs whispercpp"
	depends on !BR2_PACKAGE_WHISPERCPP
```

## package/whispercpp/Config.in
```kconfig
config BR2_PACKAGE_WHISPERCPP
	bool "whispercpp"
	depends on BR2_INSTALL_LIBSTDCPP
	depends on BR2_TOOLCHAIN_HAS_THREADS
	help
	  whisper.cpp is a CPU-friendly C/C++ inference of OpenAI's
	  Whisper automatic speech recognition model, built on ggml.

	  Mutebox uses the whisper-cli binary offline to transcribe
	  saved commercial audio clips so it can identify the
	  commercial by name, in the background, off the audio
	  detection hot path.

	  https://github.com/ggml-org/whisper.cpp

comment "whispercpp needs a toolchain w/ C++, threads"
	depends on !BR2_INSTALL_LIBSTDCPP || !BR2_TOOLCHAIN_HAS_THREADS
```
